## drivers/bytedance/multi_hook/Kconfig
```kconfig
#
# Bytedance module configuration
#
config BYTEDANCE_MULTI_HOOK
	tristate "bytedance multi_hook module"
	default n
	depends on X86_64
	---help---
	  this module is multi_hook

	  detail at https://bytedance.feishu.cn/wiki/wikcnIUoLqVsIn4dUyPcFEJSn0b

	  for const_func_hook now only supports x86_64, so multi_hook now also 
	  only supports x86_64.
```

## drivers/bytedance/smith/Kconfig
```kconfig
#
# Bytedance module configuration
#
config BYTEDANCE_SMITH
	tristate "bytedance HIDS module - smith"
        depends on KPROBES && KRETPROBES
	---help---
	  ByteDance HIDS kernel module
          Project: https://github.com/bytedance/elkeid
```

## kernel/bpf/Kconfig
```kconfig
# SPDX-License-Identifier: GPL-2.0-only

# BPF interpreter that, for example, classic socket filters depend on.
config BPF
	bool

# Used by archs to tell that they support BPF JIT compiler plus which flavour.
# Only one of the two can be selected for a specific arch since eBPF JIT supersedes
# the cBPF JIT.

# Classic BPF JIT (cBPF)
config HAVE_CBPF_JIT
	bool

# Extended BPF JIT (eBPF)
config HAVE_EBPF_JIT
	bool

menu "BPF subsystem"

config BPF_SYSCALL
	bool "Enable bpf() system call"
	select BPF
	select IRQ_WORK
	default n
	help
	  Enable the bpf() system call that allows to manipulate eBPF
	  programs and maps via file descriptors.

config BPF_JIT
	bool "enable BPF Just In Time compiler"
	depends on BPF
	depends on HAVE_CBPF_JIT || HAVE_EBPF_JIT
	depends on MODULES
	---help---
	  Berkeley Packet Filter filtering capabilities are normally handled
	  by an interpreter. This option allows kernel to generate a native
	  code when filter is loaded in memory. This should speedup
	  packet sniffing (libpcap/tcpdump).

	  Note, admin should enable this feature changing:
	  /proc/sys/net/core/bpf_jit_enable
	  /proc/sys/net/core/bpf_jit_harden   (optional)
	  /proc/sys/net/core/bpf_jit_kallsyms (optional)

config BPF_JIT_ALWAYS_ON
	bool "Permanently enable BPF JIT and remove BPF interpreter"
	depends on BPF_SYSCALL && HAVE_EBPF_JIT && BPF_JIT
	help
	  Enables BPF JIT and removes BPF interpreter to avoid
	  speculative execution of BPF instructions by the interpreter

config BPF_UNPRIV_DEFAULT_OFF
	bool "Disable unprivileged BPF by default"
	depends on BPF_SYSCALL
	help
	  Disables unprivileged BPF by default by setting the corresponding
	  /proc/sys/kernel/unprivileged_bpf_disabled knob to 2. An admin can
	  still reenable it by setting it to 0 later on, or permanently
	  disable it by setting it to 1 (from which no other transition to
	  0 is possible anymore).

config BPF_UNSAFE_HELPER
	bool "Enable using bpf_unsafe_helper"
	depends on BPF_SYSCALL
	help
	  Enable using bpf_unsafe_helper which can call modules functions in
	  bpf prog.

endmenu # "BPF subsystem"
```
